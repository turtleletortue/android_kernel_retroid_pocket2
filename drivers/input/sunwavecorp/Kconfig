## drivers/input/sunwavecorp/Kconfig
```kconfig
menu "sunwavecorp sensor Device"

menuconfig SUNWAVECORP
        tristate "sunwavecorp fp sensor "
        default y
        ---help---
          Say Y here for supporting sunwavecorp sensor

if SUNWAVECORP

choice
	prompt "sunwavecorp sensor for"
	default SUNWAVECORP_MT6797  

config SUNWAVECORP_MT6797
        bool " MT6797 with dts"
        default y
        ---help---
          sunwavecorp sensor for MT6797 with dts          
endchoice

endif

endmenu
```

## drivers/input/touchscreen/mediatek/GT5668/Kconfig
```kconfig
#
# Touchscreen driver configuration
#
if TOUCHSCREEN_MTK_GT5668
    
config GT5668_PROXIMITY
	bool "use touch panel to implement proximity sensor"
	default y
	help
	Say Y here if you want to use touch panel to implement psensor.

	If unsure, say N.

	To compile this dirver as a module, choose M here: the
	module will be called.
    
endif
```

## drivers/input/touchscreen/mediatek/ft6x36/Kconfig
```kconfig
#
# Touchscreen driver configuration
#
if TOUCHSCREEN_MTK_FT6X36
    
config FT6X36_PROXIMITY
	bool "use touch panel to implement proximity sensor"
	default y
	help
	Say Y here if you want to use touch panel to implement psensor.

	If unsure, say N.

	To compile this dirver as a module, choose M here: the
	module will be called.
    
endif
```

## drivers/input/touchscreen/mediatek/ft6x36__bak/Kconfig
```kconfig
#
# Touchscreen driver configuration
#
if TOUCHSCREEN_MTK_FT6X36
    
config FT6X36_PROXIMITY
	bool "use touch panel to implement proximity sensor"
	default y
	help
	Say Y here if you have ft5x0x touch panel FT_AUTO_UPGRADE_SUPPORT.

	If unsure, say N.

	To compile this dirver as a module, choose M here: the
	module will be called.

config CUST_FTS_APK_DEBUG
	bool "ft5x0x for Mediatek package"
	default y
	help
	Say Y here if you have ft5x0x touch panel CUST_FTS_APK_DEBUG.

	If unsure, say N.

	To compile this dirver as a module, choose M here: the
	module will be called.

config TPD_HAVE_CALIBRATION
	bool "ft5x0x for Mediatek package"
	default n
	help
	Say Y here if you have ft5x0x touch panel TPD_HAVE_CALIBRATION.

	If unsure, say N.

	To compile this dirver as a module, choose M here: the
	module will be called.

config TPD_CUSTOM_CALIBRATION
	bool "ft5x0x for Mediatek package"
	default n
	help
	Say Y here if you have ft5x0x touch panel TPD_CUSTOM_CALIBRATION.

	If unsure, say N.

	To compile this dirver as a module, choose M here: the
	module will be called.
endif
```

## drivers/misc/mediatek/accelerometer/msa300/Kconfig
```kconfig
config MTK_MSA300
	bool "MSA300 for MediaTek package"
	default n
	help
	  It support different accelerometer sensor.
          If this option is set,
	  it will support
          MSA300 Accelerometer.
```

## drivers/misc/mediatek/devapc/Kconfig
```kconfig
config MTK_DEVAPC_DRIVER
	bool "Enable MTK Device APC driver"
	default n
	help
	  Device APC is a kernel driver controlling internal device security

config MTK_DEBUGSYS_LOCK
	bool "Lock the debugsys reg"
	default n
	help
	  block debugsys to mitigate privilege escalation through debugsys.
```

## drivers/misc/mediatek/flashlight/Kconfig
```kconfig
config MTK_FLASHLIGHT
  bool CONFIG_MTK_FLASHLIGHT
  default n
  help
    CONFIG_MTK_FLASHLIGHT

config CUSTOM_KERNEL_FLASHLIGHT
        string "CUSTOM_KERNEL_FLASHLIGHT"
        help
          Kernel space cameara flashlight driver. You can use this driver
          choose cameara flashlight type.

config FLASHLIGHT_ISINK_MODE
  bool "use isink 0&1&2 to power on flashlight"
  default n
  help
    Say Y here if your board use isink 0&1&2 to power on flashlight
    
config FLASHLIGHT_GPIO_MODE
  bool "use gpio to power on flashlight"
  default n
  help
    Say Y here if your board use gpio to power on flashlight
```

## drivers/misc/mediatek/gyroscope/bmi160_gyro/Kconfig
```kconfig
config MTK_BMI160_GYRO
        bool "BMI160_GYRO for MediaTek package"
        default n
        help
        It support different gyroscope sensor.
        If this option is set,
	  	it will support
         BMI160_GYRO gyroscope.
```

## drivers/misc/mediatek/magnetometer/af7133e/Kconfig
```kconfig
config MTK_AF7133E
	bool "AF7133E for MediaTek package"
	default n
	help
	  It support different magnetometer sensor.
          If this option is set,
	  it will support
          AF7133E magnetometer.
```

## drivers/misc/retroarch/Kconfig
```kconfig
menuconfig RETROARCH_PLATFORM
	bool "RetroArch Platform Configuration"
	select FW_LOADER_USER_HELPER_FALLBACK
	help
	  Check this to enable RetroArch Platform configuration.

if RETROARCH_PLATFORM

source "drivers/misc/retroarch/fpga/Kconfig"
source "drivers/misc/retroarch/hdmi/Kconfig"

endif

menuconfig RETROARCH_PLATFORM_POCKET1
	bool "RetroArch Platform Configuration Pocket1"
	select FW_LOADER_USER_HELPER_FALLBACK
	help
	  Check this to enable RetroArch Platform configuration on Retroid Pocket 1.

if RETROARCH_PLATFORM

source "drivers/misc/retroarch/fpga_pocket1/Kconfig"
source "drivers/misc/retroarch/hdmi_pocket1/Kconfig"

endif
```

## fs/sefs/Kconfig
```kconfig
config SEFS_FS
	tristate "Sefs filesystem layer support"
	depends on KEYS && CRYPTO
	select CRYPTO_ECB
	select CRYPTO_CBC
	select CRYPTO_MD5
	help
	  Sefs filesystem that operates on the VFS layer. 

	  To compile this file system support as a module, choose M here: the
	  module will be called sefs.

config SEFS_FS_MESSAGING
	bool "Enable notifications for userspace key wrap/unwrap"
	depends on SEFS_FS
	help
	  Enables the /dev/sefs entry.
```
